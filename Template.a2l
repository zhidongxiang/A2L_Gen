ASAP2_VERSION 1 60
/begin PROJECT ECU "DXPL1"
/begin HEADER "project header description" VERSION "DXPL_XCP" PROJECT_NO DXPL1 /end HEADER
/begin MODULE DIM ""
/begin MOD_PAR "DXPL1" VERSION "ABCD001" /*ADDR_EPK 0x12345*/ /*EPK ""*/ SUPPLIER "DXT" CUSTOMER "Tester" CUSTOMER_NO "0" USER "" PHONE_NO "" ECU "" CPU_TYPE "STM"
 /begin MEMORY_SEGMENT Pst08000000 "" CODE FLASH INTERN 0x08000000 0x6000 -1 -1 -1 -1 -1
  /begin IF_DATA XCPplus 0x0102
   /begin SEGMENT 0 /* segment logical number */ 0x01 /* number of pages */ 0x00 /* address extension */ 0x00 /* compression method */ 0x00 /* encryption method */
    /begin CHECKSUM XCP_CRC_32 /* checksum: add bytes to 16bit result */ MAX_BLOCK_SIZE 0x4000 /end CHECKSUM
    /begin PAGE 0x00 ECU_ACCESS_DONT_CARE XCP_READ_ACCESS_DONT_CARE XCP_WRITE_ACCESS_NOT_ALLOWED /end PAGE
   /end SEGMENT
  /end IF_DATA
 /end MEMORY_SEGMENT
 /begin MEMORY_SEGMENT 0x08008000 "" DATA FLASH INTERN 0x08006000 0x6000 -1 -1 -1 -1 -1
  /begin IF_DATA XCPplus 0x0102
   /begin SEGMENT 1 /* segment logical number */ 0x02 /* number of pages */ 0x00 /* address extension */ 0x00 /* compression method */ 0x00 /* encryption method */
    /begin CHECKSUM XCP_CRC_32 /* checksum: add bytes to 16bit result */ MAX_BLOCK_SIZE 0xFFFFFFFF /end CHECKSUM
    /begin PAGE 0x00 ECU_ACCESS_DONT_CARE XCP_READ_ACCESS_DONT_CARE XCP_WRITE_ACCESS_NOT_ALLOWED /end PAGE
    /begin PAGE 0x01 ECU_ACCESS_DONT_CARE XCP_READ_ACCESS_DONT_CARE XCP_WRITE_ACCESS_WITH_ECU_ONLY /end PAGE
   /end SEGMENT
  /end IF_DATA
 /end MEMORY_SEGMENT
 /begin MEMORY_SEGMENT Ram20000000 "" VARIABLES RAM INTERN 0x20000000 0x2000 -1 -1 -1 -1 -1 /end MEMORY_SEGMENT
/end MOD_PAR
/begin MOD_COMMON "" BYTE_ORDER MSB_LAST ALIGNMENT_BYTE 1 ALIGNMENT_WORD 2 ALIGNMENT_LONG 4 ALIGNMENT_FLOAT32_IEEE 4 ALIGNMENT_FLOAT64_IEEE 4 /end MOD_COMMON
/begin IF_DATA XCPplus 0x0102 /*************** start of PROTOCOL_LAYER *******************/
 /begin PROTOCOL_LAYER 0x0102 /* XCP protocol layer version */ 5000 /* T1 [ms] */ 5000 /* T2 [ms] */ 0 /* T3 [ms] */ 0 /* T4 [ms] */ 0 /* T5 [ms] */ 0 /* T6 [ms] */ 0 /* T7 [ms] */ 8 /* MAX_CTO */ 8 /* MAX_DTO default for DAQ and STIM */ BYTE_ORDER_MSB_FIRST /* BYTE_ORDER: MOTOR */ ADDRESS_GRANULARITY_BYTE /* ADDRESS_GRANULARITY */ OPTIONAL_CMD SET_MTA OPTIONAL_CMD UPLOAD OPTIONAL_CMD SHORT_UPLOAD OPTIONAL_CMD BUILD_CHECKSUM OPTIONAL_CMD DOWNLOAD OPTIONAL_CMD DOWNLOAD_NEXT OPTIONAL_CMD DOWNLOAD_MAX OPTIONAL_CMD SET_CAL_PAGE OPTIONAL_CMD GET_CAL_PAGE OPTIONAL_CMD COPY_CAL_PAGE OPTIONAL_CMD CLEAR_DAQ_LIST OPTIONAL_CMD SET_DAQ_PTR OPTIONAL_CMD WRITE_DAQ OPTIONAL_CMD SET_DAQ_LIST_MODE OPTIONAL_CMD GET_DAQ_LIST_MODE OPTIONAL_CMD START_STOP_DAQ_LIST OPTIONAL_CMD START_STOP_SYNCH OPTIONAL_CMD FREE_DAQ OPTIONAL_CMD ALLOC_DAQ OPTIONAL_CMD ALLOC_ODT OPTIONAL_CMD ALLOC_ODT_ENTRY COMMUNICATION_MODE_SUPPORTED /* optional modes supported */ BLOCK SLAVE /* Slave Block Mode supported */ MASTER /* Master Block Mode supported */ 43 /* MAX_BS */ 0 /* MIN_ST */ /end PROTOCOL_LAYER
 /***************** end of PROTOCOL_LAYER *******************/ /********************* start of DAQ ************************/
 /begin DAQ /* DAQ supported, at MODULE*/ DYNAMIC /* DAQ_CONFIG_TYPE */ 65535 /* MAX_DAQ */ 65535 /* MAX_EVENT_CHANNEL */ 0 /* MIN_DAQ */ OPTIMISATION_TYPE_ODT_TYPE_ALIGNMENT /* OPTIMISATION_TYPE */ ADDRESS_EXTENSION_FREE /* ADDRESS_EXTENSION */ IDENTIFICATION_FIELD_TYPE_ABSOLUTE /* IDENTIFICATION_FIELD */ GRANULARITY_ODT_ENTRY_SIZE_DAQ_BYTE /* GRANULARITY_ODT_ENTRY_SIZE_DAQ */ 255 /* MAX_ODT_ENTRY_SIZE_DAQ */ OVERLOAD_INDICATION_EVENT /* OVERLOAD_INDICATION */ PRESCALER_SUPPORTED
  /begin DAQ_MEMORY_CONSUMPTION 4000 /* DAQ_MEMORY_LIMIT: in Elements[AG] */ 12 /* DAQ_SIZE: number of elements[AG] per DAQ list */ 6 /* ODT_SIZE: number of elements[AG] per ODT */ 8 /* ODT_ENTRY_SIZE: number of elements[AG] per ODT_entry */ 8 /* ODT_DAQ_BUFFER_ELEMENT_SIZE: number of */ /* payload elements[AG]*factor = sizeof(send buffer)[AG] */ 0 /* ODT_STIM_BUFFER_ELEMENT_SIZE: number of */ /* payload elements[AG]*factor = sizeof(receive buffer)[AG] */ /end DAQ_MEMORY_CONSUMPTION
  /******************* start of EVENT ************************/
  /begin EVENT "2.5ms time synchronous" "2.5_ms" 0 DAQ 1 25 5 /* EVENT_CHANNEL_TIME_UNIT: UNIT_100US */ 9 /end EVENT
  /begin EVENT "5ms time synchronous" "5_ms" 1 DAQ 1 5 6 8 /end EVENT
  /begin EVENT "10ms time synchronous" "10_ms" 2 DAQ 1 10 6 7 /end EVENT
  /begin EVENT "20ms time synchronous" "20_ms" 3 DAQ 1 20 6 6 /end EVENT
  /********************* end of EVENT ************************/ /end DAQ
 /********************* end of DAQ **************************/ /************************ start of CAN *********************/
 /begin XCP_ON_CAN 0x0102 /* XCP on CAN version */ CAN_ID_MASTER 0x6B0 /* CMD/STIM CAN-ID */ /* master -> slave */ CAN_ID_SLAVE 0x6B1 /* RES/ERR/EV/SERV/DAQ CAN-ID */ /* slave -> master */ /* Bit31= 1: extended identifier */ BAUDRATE 500000 /* BAUDRATE [Hz] */ SAMPLE_POINT 80 /* sample point */ /* [% complete bit time] */ SAMPLE_RATE SINGLE /* 1 sample per bit */ BTL_CYCLES 10 /* BTL_CYCLES */ /* [slots per bit time] */ SJW 1 /* length synchr. segment */ /* [BTL_CYCLES] */ SYNC_EDGE SINGLE /* on falling edge only */ MAX_DLC_REQUIRED MAX_BUS_LOAD 100 /* maximum available bus */ /begin EVENT_CAN_ID_LIST 0 FIXED 0x6B2 /end EVENT_CAN_ID_LIST /begin EVENT_CAN_ID_LIST 1 FIXED 0x6B3 /end EVENT_CAN_ID_LIST /begin EVENT_CAN_ID_LIST 2 FIXED 0x6B4 /end EVENT_CAN_ID_LIST /begin EVENT_CAN_ID_LIST 3 FIXED 0x6B5 /end EVENT_CAN_ID_LIST TRANSPORT_LAYER_INSTANCE "Transport Layer 0" /end XCP_ON_CAN
/end IF_DATA
/begin MEASUREMENT Meas_data0_u8 "" UBYTE OneToOne 1 100 0.00 255.0 FORMAT "%5.1" ECU_ADDRESS 0x20000027 /end MEASUREMENT
/begin MEASUREMENT Meas_data1_u8 "" UBYTE OneToOne 1 100 0.00 255.0 FORMAT "%5.1" ECU_ADDRESS 0x20000028 /end MEASUREMENT
/begin MEASUREMENT Meas_data2_u8 "" UBYTE OneToOne 1 100 0.00 255.0 FORMAT "%5.1" ECU_ADDRESS 0x20000029 /end MEASUREMENT
/begin MEASUREMENT Meas_data3_u8 "" UBYTE OneToOne 1 100 0.00 255.0 FORMAT "%5.1" ECU_ADDRESS 0x2000002a /end MEASUREMENT
/begin MEASUREMENT Meas_data4_u8 "" UBYTE OneToOne 1 100 0.00 255.0 FORMAT "%5.1" ECU_ADDRESS 0x2000002b /end MEASUREMENT
/begin MEASUREMENT Meas_data5_u8 "" UBYTE OneToOne 1 100 0.00 255.0 FORMAT "%5.1" ECU_ADDRESS 0x2000002c /end MEASUREMENT
/begin MEASUREMENT Meas_data6_u8 "" UBYTE OneToOne 1 100 0.00 255.0 FORMAT "%5.1" ECU_ADDRESS 0x2000002d /end MEASUREMENT
/begin MEASUREMENT Meas_data7_u8 "" UBYTE OneToOne 1 100 0.00 255.0 FORMAT "%5.1" ECU_ADDRESS 0x2000002e /end MEASUREMENT
/begin MEASUREMENT Meas_data8_u8 "" UBYTE OneToOne 1 100 0.00 255.0 FORMAT "%5.1" ECU_ADDRESS 0x2000002f /end MEASUREMENT
/begin MEASUREMENT Meas_data9_u8 "" UBYTE OneToOne 1 100 0.00 255.0 FORMAT "%5.1" ECU_ADDRESS 0x20000030 /end MEASUREMENT
/begin MEASUREMENT Meas_data0_u16 "" UWORD OneToOne 1 100 0.00 65535.0 FORMAT "%5.1" ECU_ADDRESS 0x20000032 /end MEASUREMENT
/begin MEASUREMENT Meas_data1_u16 "" UWORD OneToOne 1 100 0.00 65535.0 FORMAT "%5.1" ECU_ADDRESS 0x20000034 /end MEASUREMENT
/begin MEASUREMENT Meas_data2_u16 "" UWORD OneToOne 1 100 0.00 65535.0 FORMAT "%5.1" ECU_ADDRESS 0x20000036 /end MEASUREMENT
/begin MEASUREMENT Meas_data3_u16 "" UWORD OneToOne 1 100 0.00 65535.0 FORMAT "%5.1" ECU_ADDRESS 0x20000038 /end MEASUREMENT
/begin MEASUREMENT Meas_data4_u16 "" UWORD OneToOne 1 100 0.00 65535.0 FORMAT "%5.1" ECU_ADDRESS 0x2000003a /end MEASUREMENT
/begin MEASUREMENT Meas_data5_u16 "" UWORD OneToOne 1 100 0.00 65535.0 FORMAT "%5.1" ECU_ADDRESS 0x2000003c /end MEASUREMENT
/begin MEASUREMENT Meas_data6_u16 "" UWORD OneToOne 1 100 0.00 65535.0 FORMAT "%5.1" ECU_ADDRESS 0x2000003e /end MEASUREMENT
/begin MEASUREMENT Meas_data7_u16 "" UWORD OneToOne 1 100 0.00 65535.0 FORMAT "%5.1" ECU_ADDRESS 0x20000040 /end MEASUREMENT
/begin MEASUREMENT Meas_data8_u16 "" UWORD OneToOne 1 100 0.00 65535.0 FORMAT "%5.1" ECU_ADDRESS 0x20000042 /end MEASUREMENT
/begin MEASUREMENT Meas_data9_u16 "" UWORD OneToOne 1 100 0.00 65535.0 FORMAT "%5.1" ECU_ADDRESS 0x20000044 /end MEASUREMENT
/begin MEASUREMENT Meas_data0_u32 "" ULONG OneToOne 1 100 0.00 4294967295.00 FORMAT "%13.2" ECU_ADDRESS 0x20000048 /end MEASUREMENT
/begin MEASUREMENT Meas_data1_u32 "" ULONG OneToOne 1 100 0.00 4294967295.00 FORMAT "%13.2" ECU_ADDRESS 0x2000004c /end MEASUREMENT
/begin MEASUREMENT Meas_data2_u32 "" ULONG OneToOne 1 100 0.00 4294967295.00 FORMAT "%13.2" ECU_ADDRESS 0x20000050 /end MEASUREMENT
/begin MEASUREMENT Meas_data3_u32 "" ULONG OneToOne 1 100 0.00 4294967295.00 FORMAT "%13.2" ECU_ADDRESS 0x20000054 /end MEASUREMENT
/begin MEASUREMENT Meas_data4_u32 "" ULONG OneToOne 1 100 0.00 4294967295.00 FORMAT "%13.2" ECU_ADDRESS 0x20000058 /end MEASUREMENT
/begin MEASUREMENT Meas_data5_u32 "" ULONG OneToOne 1 100 0.00 4294967295.00 FORMAT "%13.2" ECU_ADDRESS 0x2000005c /end MEASUREMENT
/begin MEASUREMENT Meas_data6_u32 "" ULONG OneToOne 1 100 0.00 4294967295.00 FORMAT "%13.2" ECU_ADDRESS 0x20000060 /end MEASUREMENT
/begin MEASUREMENT Meas_data7_u32 "" ULONG OneToOne 1 100 0.00 4294967295.00 FORMAT "%13.2" ECU_ADDRESS 0x20000064 /end MEASUREMENT
/begin MEASUREMENT Meas_data8_u32 "" ULONG OneToOne 1 100 0.00 4294967295.00 FORMAT "%13.2" ECU_ADDRESS 0x20000068 /end MEASUREMENT
/begin MEASUREMENT Meas_data9_u32 "" ULONG OneToOne 1 100 0.00 4294967295.00 FORMAT "%13.2" ECU_ADDRESS 0x2000006c /end MEASUREMENT
/begin CHARACTERISTIC tst_c_valA1_u8 "" VALUE 0x08006000 STANDARD_VALUE_U8 255.0 OneToOne 0.00 255.0 FORMAT "%5.1" /end CHARACTERISTIC
/begin CHARACTERISTIC tst_c_valA2_u8 "" VALUE 0x08006001 STANDARD_VALUE_U8 255.0 OneToOne 0.00 255.0 FORMAT "%5.1" /end CHARACTERISTIC
/begin CHARACTERISTIC tst_c_valA3_u16 "" VALUE 0x08006002 STANDARD_VALUE_U16 65535.0 OneToOne 0.00 65535.0 FORMAT "%8.2" /end CHARACTERISTIC
/begin CHARACTERISTIC tst_c_valA4_u16 "" VALUE 0x08006004 STANDARD_VALUE_U16 65535.0 OneToOne 0.00 65535.0 FORMAT "%8.2" /end CHARACTERISTIC
/begin CHARACTERISTIC tst_c_valA5_u32 "" VALUE 0x08006008 STANDARD_VALUE_U32 4294967295.00 OneToOne 0.00 4294967295.00 FORMAT "%13.2" /end CHARACTERISTIC
/begin COMPU_METHOD OneToOne "" RAT_FUNC "%6.2" "-" COEFFS 0 1 0 0 0 1 /end COMPU_METHOD
/begin RECORD_LAYOUT STANDARD_VALUE_U8 FNC_VALUES 1 UBYTE COLUMN_DIR DIRECT /end RECORD_LAYOUT
/begin RECORD_LAYOUT STANDARD_VALUE_U16 FNC_VALUES 1 UWORD COLUMN_DIR DIRECT /end RECORD_LAYOUT
/begin RECORD_LAYOUT STANDARD_VALUE_U32 FNC_VALUES 1 ULONG COLUMN_DIR DIRECT /end RECORD_LAYOUT
/end MODULE
/end PROJECT
